## conf/machine/include/u53.inc
```bitbake
EXTRA_OECONF_append_pn-enigma2 = "--with-lcddev=/dev/null --with-alphablendingacceleration=always"

SOC_FAMILY = "hisi3798cv200"

KERNEL_MODULE_AUTOLOAD += "88x2bu"

require conf/machine/include/dinobot-cortexa15.inc
require conf/machine/include/dinobot-emmc.inc

PREFERRED_PROVIDER_virtual/blindscan-dvbs = "dinobot-blindscan-u53"

MACHINE_ESSENTIAL_EXTRA_RDEPENDS += "\
	dinobot-dvb-modules-u53 \
	dinobot-libs-u53 \
	dinobot-hihalt-u53 \
	"

PREFERRED_RPROVIDER_showiframe = "dinobot-showiframe-u53"
PREFERRED_RPROVIDER_aio-grab = "dinobot-grab-u53"

MACHINETYPE = "u53"

MTD_KERNEL = "mmcblk0p10"
MTD_ROOTFS = "mmcblk0p13"

SDCARDIMG = "no"

MACHINE_FEATURES += "7segment dvb-c blindscan-dvbs textlcd hiaccel"

IMAGEDIR = "dinobot/u53"
```

## conf/machine/include/u532.inc
```bitbake
EXTRA_OECONF_append_pn-enigma2 = "--with-lcddev=/dev/null --with-alphablendingacceleration=always"

SOC_FAMILY = "hisi3798cv200"
HICHIPSET = "3798cv200"
CHIPSET = "Hi3798Cv200"

require conf/machine/include/dinobot-cortexa15.inc
require conf/machine/include/dinobot-emmc.inc

PREFERRED_PROVIDER_virtual/blindscan-dvbs = "dinobot-blindscan-u532"

MACHINE_ESSENTIAL_EXTRA_RDEPENDS += "\
	dinobot-dvb-modules-u532 \
	dinobot-libs-u532 \
	dinobot-hihalt-u532 \
	"

PREFERRED_RPROVIDER_showiframe = "dinobot-showiframe-u532"
PREFERRED_RPROVIDER_aio-grab = "dinobot-grab-u532"

MACHINETYPE = "u532"

MTD_KERNEL = "mmcblk0p10"
MTD_ROOTFS = "mmcblk0p13"

SDCARDIMG = "no"

MACHINE_FEATURES += "7segment hiaccel"

IMAGEDIR = "e2/update"

STB_PLATFORM = "u532"
```

## conf/machine/include/u533.inc
```bitbake
EXTRA_OECONF_append_pn-enigma2 = "--with-lcddev=/dev/null --with-alphablendingacceleration=always"

SOC_FAMILY = "hisi3798cv200"

require conf/machine/include/dinobot-cortexa15.inc
require conf/machine/include/dinobot-emmc.inc

PREFERRED_PROVIDER_virtual/blindscan-dvbs = "dinobot-blindscan-u533"

MACHINE_ESSENTIAL_EXTRA_RDEPENDS += "\
	dinobot-dvb-modules-u533 \
	dinobot-libs-u533 \
	dinobot-hihalt-u533 \
	"

PREFERRED_RPROVIDER_showiframe = "dinobot-showiframe-u533"
PREFERRED_RPROVIDER_aio-grab = "dinobot-grab-u533"

MACHINETYPE = "u533"

MTD_KERNEL = "mmcblk0p10"
MTD_ROOTFS = "mmcblk0p13"

SDCARDIMG = "no"

MACHINE_FEATURES += "7segment hiaccel"

IMAGEDIR = "e2/update"

STB_PLATFORM = "u533"
```

## conf/machine/include/u54.inc
```bitbake
EXTRA_OECONF_append_pn-enigma2 = "--with-lcddev=/dev/null --with-alphablendingacceleration=always"

SOC_FAMILY = "hisi3798mv200"
HICHIPSET = "3798mv200"
CHIPSET = "Hi3798Mv200"

KERNEL_MODULE_AUTOLOAD += "8192eu"

require conf/machine/include/dinobot-cortexa15.inc
require conf/machine/include/dinobot-emmc.inc

PREFERRED_PROVIDER_virtual/blindscan-dvbs = "dinobot-blindscan-u54"

MACHINE_ESSENTIAL_EXTRA_RDEPENDS += "\
	dinobot-dvb-modules-u54 \
	dinobot-libs-u54 \
	dinobot-hihalt-u54 \
	"

PREFERRED_RPROVIDER_showiframe = "dinobot-showiframe-u54"
PREFERRED_RPROVIDER_aio-grab = "dinobot-grab-u54"

MACHINETYPE = "u54"

MTD_KERNEL = "mmcblk0p10"
MTD_ROOTFS = "mmcblk0p13"

SDCARDIMG = "no"

MACHINE_FEATURES += "7segment blindscan-dvbs textlcd hiaccel RCA"

IMAGEDIR = "dinobot/u54"

STB_PLATFORM = "u54"

EXTRA_ALSA = "mv200"
```

## conf/machine/include/u55.inc
```bitbake
EXTRA_OECONF_append_pn-enigma2 = "--with-lcddev=/dev/null --with-alphablendingacceleration=always"

SOC_FAMILY = "hisi3798mv200"

KERNEL_MODULE_AUTOLOAD += "rt8188fu"

require conf/machine/include/dinobot-cortexa15.inc
require conf/machine/include/dinobot-ubi.inc

PREFERRED_PROVIDER_virtual/blindscan-dvbs = "dinobot-blindscan-u55"

MACHINE_ESSENTIAL_EXTRA_RDEPENDS += "\
	dinobot-dvb-modules-u55 \
	dinobot-libs-u55 \
	dinobot-hihalt-u55 \
	"

PREFERRED_RPROVIDER_showiframe = "dinobot-showiframe-u55"
PREFERRED_RPROVIDER_aio-grab = "dinobot-grab-u55"

MACHINETYPE = "u55"

MTD_KERNEL = "mtd10"
MTD_ROOTFS = "mtd11"

SDCARDIMG = "no"

MACHINE_FEATURES += "7segment blindscan-dvbs textlcd hiaccel RCA"
```

## conf/machine/include/u56.inc
```bitbake
EXTRA_OECONF_append_pn-enigma2 = "--with-lcddev=/dev/null --with-alphablendingacceleration=always"

SOC_FAMILY = "hisi3798mv200"

KERNEL_MODULE_AUTOLOAD += "8192eu"

require conf/machine/include/dinobot-cortexa15.inc
require conf/machine/include/dinobot-emmc.inc

PREFERRED_PROVIDER_virtual/blindscan-dvbs = "dinobot-blindscan-u56"

MACHINE_ESSENTIAL_EXTRA_RDEPENDS += "\
	dinobot-dvb-modules-u56 \
	dinobot-libs-u56 \
	dinobot-hihalt-u56 \
	"

PREFERRED_RPROVIDER_showiframe = "dinobot-showiframe-u56"
PREFERRED_RPROVIDER_aio-grab = "dinobot-grab-u56"

MACHINETYPE = "u56"

MTD_KERNEL = "mmcblk0p9"
MTD_ROOTFS = "mmcblk0p10"

SDCARDIMG = "no"

MACHINE_FEATURES += "blindscan-dvbs 7segment textlcd hiaccel"

IMAGEDIR = "axas/axasc4k"
```

## conf/machine/include/u57.inc
```bitbake
EXTRA_OECONF_append_pn-enigma2 = "--with-lcddev=/dev/null --with-alphablendingacceleration=always"

SOC_FAMILY = "hisi3798mv200"
HICHIPSET = "3798mv200"
CHIPSET = "Hi3798Mv200"

KERNEL_MODULE_AUTOLOAD += "rt8188fu"

require conf/machine/include/dinobot-cortexa15.inc
require conf/machine/include/dinobot-emmc.inc

PREFERRED_PROVIDER_virtual/blindscan-dvbs = "dinobot-blindscan-u57"

MACHINE_ESSENTIAL_EXTRA_RDEPENDS += "\
	dinobot-dvb-modules-u57 \
	dinobot-libs-u57 \
	dinobot-hihalt-u57 \
	"

PREFERRED_RPROVIDER_showiframe = "dinobot-showiframe-u57"
PREFERRED_RPROVIDER_aio-grab = "dinobot-grab-u57"

MACHINETYPE = "u57"

SDCARDIMG = "no"

MACHINE_FEATURES += "blindscan-dvbs 7segment hiaccel RCA"

IMAGEDIR = "amiko/${MACHINE}"

STB_PLATFORM = "u57"

EXTRA_ALSA = "mv200"

RCNAME = "amiko6"
```

## conf/machine/include/u5pvr.inc
```bitbake
EXTRA_OECONF_append_pn-enigma2 = "--with-lcddev=/dev/null --with-alphablendingacceleration=always"

SOC_FAMILY = "hisi3798cv200"
HICHIPSET = "3798cv200"
CHIPSET = "Hi3798Cv200"

KERNEL_MODULE_AUTOLOAD += "\
	brcmutil \
	brcmfmac \
	"

require conf/machine/include/dinobot-cortexa15.inc
require conf/machine/include/dinobot-emmc.inc

MACHINE_ESSENTIAL_EXTRA_RDEPENDS += "\
	kernel-module-brcmutil \
	kernel-module-brcmfmac \
	dinobot-dvb-modules-u5pvr \
	dinobot-libs-u5pvr \
	dinobot-hihalt-u5pvr \
	"

PREFERRED_RPROVIDER_showiframe = "dinobot-showiframe-u5pvr"
PREFERRED_RPROVIDER_aio-grab = "dinobot-grab-u5pvr"

MACHINETYPE = "u5pvr"

MTD_KERNEL = "mmcblk0p10"
MTD_ROOTFS = "mmcblk0p13"

SDCARDIMG = "no"

MACHINE_FEATURES += "7segment dvb-c textlcd RCA"

IMAGEDIR = "dinobot/u5pvr"

STB_PLATFORM = "u5pvr"
```

## conf/machine/iziboxecohd.conf
```bitbake
#
# This is config file for IZIBox Eco Twin HD and SpyCat Mini V2
#

require conf/machine/include/u42.inc

IMAGEDIR = "dinobot/${MACHINE}"
```

## conf/machine/iziboxelite4k.conf
```bitbake
#
# This is config file for IZIBox Elite 4K
#

require conf/machine/include/u57.inc

MTD_KERNEL = "mmcblk0p9"
MTD_ROOTFS = "mmcblk0p10"

IMAGEDIR = "izibox/${MACHINETYPE}"

RCNAME = "izibox2"

DISPLAY_BRAND = "IZIBOX"
DISPLAY_MODEL = "Elite 4K"
```

## conf/machine/iziboxx3.conf
```bitbake
#
# This is config file for IZIBox X3
#

require conf/machine/include/u55.inc

IMAGEDIR = "izibox/x3"

RCNAME = "izibox1"

MACHINE_ESSENTIAL_EXTRA_RDEPENDS += "\
	enigma2-plugin-extensions-gbipboxclient \
	"
```

## conf/machine/jdhdduo.conf
```bitbake
#
# This is config file for JamesDonkey HD Duo
#

require conf/machine/include/u42.inc

IMAGEDIR = "jamesdonkey/hdduo"
```

## conf/machine/mediabox4k.conf
```bitbake
#
# This is config file for Jepssen Mediabox 4K M7L
#

EXTRA_OECONF_append_pn-enigma2 = "--with-lcddev=/dev/null --with-alphablendingacceleration=always"

SOC_FAMILY = "hisi3798mv200"

KERNEL_MODULE_AUTOLOAD += "8192eu"

require conf/machine/include/dinobot-oem.inc

MTD_KERNEL = "mmcblk0p10"
MTD_ROOTFS = "mmcblk1p1"

SDCARDIMG = "yes"

MACHINE_FEATURES += "dvb-c blindscan-dvbs"

PREFERRED_PROVIDER_virtual/blindscan-dvbs = "dinobot-blindscan-u5"

MACHINE_ESSENTIAL_EXTRA_RDEPENDS += "\
    dinobot-dvb-modules-u5 \
    dinobot-libs-u5 \
"

IMAGEDIR = "dinobot/u5"

PREFERRED_RPROVIDER_showiframe = "dinobot-showiframe-u5"
```

## conf/machine/protek4kx1.conf
```bitbake
#
# This is config file for Protek 4K X1
#

require conf/machine/include/u41.inc

IMAGEDIR = "protek/4kx1"

MTD_KERNEL = "mmcblk0p9"
MTD_ROOTFS = "mmcblk0p10"
```

## conf/machine/spycatminiv2.conf
```bitbake
#
# This is config file for SpyCat Mini V2
#

require conf/machine/include/u42.inc

IMAGEDIR = "spycat/miniv2"
```

## conf/machine/viper4kv20.conf
```bitbake
#
# This is config file for Amiko Viper 4K V20
#

require conf/machine/include/u57.inc

MTD_KERNEL = "mmcblk0p9"
MTD_ROOTFS = "mmcblk0p10"

IMAGEDIR = "amiko/${MACHINETYPE}"

RCNAME = "amiko6"

DISPLAY_BRAND = "AMIKO"
DISPLAY_MODEL = "Viper 4K V20"
```

## conf/machine/vipers.conf
```bitbake
#
# This is config file for Amiko Viper S
#

require conf/machine/include/u57.inc

MTD_KERNEL = "mtd8"
MTD_ROOTFS = "mtd9"
```

## conf/machine/vipersingle.conf
```bitbake
#
# This is config file for Amiko Viper Single
#

require conf/machine/include/u57.inc

MTD_KERNEL = "mtd8"
MTD_ROOTFS = "mtd9"

IMAGEDIR = "amiko/${MACHINETYPE}"

RCNAME = "amiko6"

DISPLAY_BRAND = "AMIKO"
DISPLAY_MODEL = "Viper Single"
```
