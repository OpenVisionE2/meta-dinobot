## conf/machine/anadol4k.conf
```bitbake
#
# This is config file for Anadol 4K Eco
#

EXTRA_OECONF_append_pn-enigma2 = "--with-lcddev=/dev/null --with-alphablendingacceleration=always"

SOC_FAMILY = "hisi3798mv200"

KERNEL_MODULE_AUTOLOAD += "8192eu"

require conf/machine/include/dinobot-cortexa15.inc
require conf/machine/include/dinobot-emmc.inc

MTD_KERNEL = "mmcblk0p9"
MTD_ROOTFS = "mmcblk0p10"

SDCARDIMG = "no"

MACHINE_FEATURES += "blindscan-dvbs"

PREFERRED_PROVIDER_virtual/blindscan-dvbs = "dinobot-blindscan-u5"

MACHINE_ESSENTIAL_EXTRA_RDEPENDS += "\
    dinobot-dvb-modules-u5 \
    dinobot-libs-u5 \
"

IMAGEDIR = "dinobot/u5"

PREFERRED_RPROVIDER_showiframe = "dinobot-showiframe-u5"
PREFERRED_PROVIDER_virtual/egl = "dinobot-opengl-u5" 
PREFERRED_PROVIDER_virtual/libgles1 = "dinobot-opengl-u5"
PREFERRED_PROVIDER_virtual/libgles2 = "dinobot-opengl-u5"
```

## conf/machine/anadol4kcombo.conf
```bitbake
#
# This is config file for Anadol 4K Combo
#

require conf/machine/include/u51.inc

SDCARDIMG = "no"

IMAGEDIR = "dinobot/u51"
```

## conf/machine/anadol4kv2.conf
```bitbake
#
# This is config file for Anadol 4K Eco V2 and Anadol 4K Combo
#

require conf/machine/include/u51.inc

SDCARDIMG = "no"

MACHINE_FEATURES += "dvb-c"

IMAGEDIR = "dinobot/u51"
```

## conf/machine/anadolprohd5.conf
```bitbake
#
# This is config file for Anadol Pro HD5
#

require conf/machine/include/u42.inc

IMAGEDIR = "anadol/prohd5"
```

## conf/machine/arivacombo.conf
```bitbake
#
# This is config file for Ferguson Ariva ATV Combo
#

require conf/machine/include/u532.inc

RCNAME = "ariva"
RCIDNUM = "1"

DISPLAY_BRAND = "Ferguson"
DISPLAY_MODEL = "ARIVA ATV COMBO"
```

## conf/machine/arivatwin.conf
```bitbake
#
# This is config file for Ferguson Ariva ATV Twin
#

require conf/machine/include/u533.inc

RCNAME = "ariva"
RCIDNUM = "1"

DISPLAY_BRAND = "Ferguson"
DISPLAY_MODEL = "ARIVA ATV TT"
```

## conf/machine/axashis4kcomboplus.conf
```bitbake
#
# This is config file for AXAS HIS 4K Combo Plus
#

EXTRA_OECONF_append_pn-enigma2 = "--with-lcddev=/dev/null --with-alphablendingacceleration=always"

SOC_FAMILY = "hisi3798mv200"

KERNEL_MODULE_AUTOLOAD += "8192eu"

require conf/machine/include/dinobot-cortexa15.inc
require conf/machine/include/dinobot-emmc.inc

MTD_KERNEL = "mmcblk0p10"
MTD_ROOTFS = "mmcblk0p13"

SDCARDIMG = "no"

MACHINE_FEATURES += "7segment dvb-c blindscan-dvbs"

PREFERRED_PROVIDER_virtual/blindscan-dvbs = "dinobot-blindscan-u52"

MACHINE_ESSENTIAL_EXTRA_RDEPENDS += "\
    dinobot-dvb-modules-u52 \
    dinobot-libs-u52 \
"

IMAGEDIR = "axas/axascomboplus"

PREFERRED_RPROVIDER_showiframe = "dinobot-showiframe-u52"
```

## conf/machine/axashistwin.conf
```bitbake
#
# This is config file for AXAS HIS Twin
#

require conf/machine/include/u41.inc

IMAGEDIR = "axas/axashistwin"
```

## conf/machine/axashistwinplus.conf
```bitbake
#
# This is config file for AXAS HIS Twin Plus
#

require conf/machine/include/u45.inc

IMAGEDIR = "axas/axashistwinplus"

DISPLAY_BRAND = "AXAS"
DISPLAY_MODEL = "HIS Twin +"
```

## conf/machine/dinobot4k.conf
```bitbake
#
# This is config file for Vivant Dinobot 4K
#

require conf/machine/include/u5.inc

MTD_KERNEL = "mmcblk0p10"
MTD_ROOTFS = "mmcblk1p1"

SDCARDIMG = "yes"

MACHINE_FEATURES += "dvb-c"
```

## conf/machine/dinobot4kmini.conf
```bitbake
#
# This is config file for Vivant Dinobot 4K Mini
#

EXTRA_OECONF_append_pn-enigma2 = "--with-lcddev=/dev/null --with-alphablendingacceleration=always"

SOC_FAMILY = "hisi3798cv200"

KERNEL_MODULE_AUTOLOAD += "88x2bu"

require conf/machine/include/dinobot-cortexa15.inc
require conf/machine/include/dinobot-emmc.inc

MTD_KERNEL = "mmcblk0p10"
MTD_ROOTFS = "mmcblk0p13"

SDCARDIMG = "no"

MACHINE_FEATURES += "7segment dvb-c blindscan-dvbs textlcd"

MACHINE_ESSENTIAL_EXTRA_RDEPENDS += "\
    dinobot-dvb-modules-u53 \
    dinobot-libs-u53 \
    dinobot-hihalt-u53 \
"

IMAGEDIR = "dinobot/u53"

PREFERRED_RPROVIDER_showiframe = "dinobot-showiframe-u53"
PREFERRED_RPROVIDER_aio-grab = "dinobot-grab-u53"
```

## conf/machine/dinobot4kplus.conf
```bitbake
#
# This is config file for Vivant Dinobot 4K Plus
#

require conf/machine/include/u52.inc

IMAGEDIR = "dinobot/${MACHINETYPE}"

DISPLAY_MODEL = "DINOBOT 4K Plus"
```

## conf/machine/dinobot4kpro.conf
```bitbake
#
# This is config file for Vivant Dinobot 4K Pro
#

require conf/machine/include/u54.inc

DISPLAY_MODEL = "DINOBOT 4K Pro"
```

## conf/machine/dinobot4kse.conf
```bitbake
#
# This is config file for Vivant Dinobot 4K SE and Ferguson U5 PVR
#

require conf/machine/include/u5pvr.inc

DISPLAY_MODEL = "DINOBOT 4KSE"
```

## conf/machine/dinobot4ktwin.conf
```bitbake
#
# This is config file for Vivant Dinobot 4K Twin
#

require conf/machine/include/u57.inc

MTD_KERNEL = "mmcblk0p10"
MTD_ROOTFS = "mmcblk0p13"

IMAGEDIR = "dinobot/${MACHINETYPE}"

RCNAME = "dinobot2"

DISPLAY_MODEL = "DINOBOT 4K Twin"
```

## conf/machine/dinoboth265.conf
```bitbake
#
# This is config file for Vivant Dinobot H265
#

require conf/machine/include/u41.inc

IMAGEDIR = "dinobot/u41"
```

## conf/machine/dinobotu43.conf
```bitbake
#
# This is config file for Dinobot U43
#

require conf/machine/include/u43.inc

IMAGEDIR = "dinobot/${MACHINETYPE}"

#DISPLAY_MODEL = "DINOBOT U43"
```

## conf/machine/dinobotu55.conf
```bitbake
#
# This is config file for Vivant Dinobot U55
#

EXTRA_OECONF_append_pn-enigma2 = "--with-lcddev=/dev/null --with-alphablendingacceleration=always"

SOC_FAMILY = "hisi3798mv200"

KERNEL_MODULE_AUTOLOAD += "8192eu"

require conf/machine/include/dinobot-cortexa15.inc
require conf/machine/include/dinobot-ubi.inc

MTD_KERNEL = "mtd10"
MTD_ROOTFS = "mtd11"

SDCARDIMG = "no"

MACHINE_FEATURES += "7segment blindscan-dvbs"

PREFERRED_PROVIDER_virtual/blindscan-dvbs = "dinobot-blindscan-u55"

MACHINE_ESSENTIAL_EXTRA_RDEPENDS += "\
    dinobot-dvb-modules-u55 \
    dinobot-libs-u55 \
    dinobot-hihalt-u55 \
"

IMAGEDIR = "dinobot/u55"

PREFERRED_RPROVIDER_showiframe = "dinobot-showiframe-u55"
PREFERRED_RPROVIDER_aio-grab = "dinobot-grab-u55"
```

## conf/machine/ferguson4k.conf
```bitbake
#
# This is config file for Ferguson U5 PVR
#

require conf/machine/include/u5pvr.inc
```

## conf/machine/include/dinobot-oem.inc
```bitbake
# We know about rtc
MACHINE_FEATURES_BACKFILL_CONSIDERED += "rtc"

BOX_BRAND = "dinobot"

KERNEL_MODULE_AUTOLOAD += "\
	xhci-plat-hcd \
	ehci-platform \
	ohci-platform \
	cfg80211 \
	"

MACHINE_ESSENTIAL_EXTRA_RDEPENDS += "\
	kernel-module-xhci-plat-hcd \
	kernel-module-ehci-platform \
	kernel-module-ohci-platform \
	dinobot-pvr \
	dinobot-lib-helper \
	dinobot-libs-${MACHINETYPE} \
	kernel-module-extrawlan-rtl8192eu \
	firmware-rtl8192eu \
	kernel-module-extrawlan-rt8822bu \
	kernel-module-extrawlan-rt8188fu \
	firmware-rt8188fu \
	${@bb.utils.contains('MACHINE_FEATURES', 'emmc', 'dinobot-resizerootfs' , '', d)} \
	dinobot-partitions-${SOC_FAMILY} \
	"

MACHINE_FEATURES += "videoenhancement switchoff hdmicec blindscan-tbs alsa multitranscoding hisil HDMI"

PREFERRED_PROVIDER_virtual/kernel = "linux-dinobot"
PREFERRED_VERSION_linux-dinobot = "4.4.35"
PREFERRED_VERSION_directfb = "1.7.7"

MACHINE_EXTRA_RRECOMMENDS += "\
	gstreamer1.0-plugin-dvbmediasink \
	"

DVBPROVIDER = "kernel"
DVBSKYPROVIDER = "kernel"

require conf/machine/include/soc-family.inc

DVBMEDIASINK_CONFIG = "--with-h265 --with-vb8 --with-vb9 --with-spark --with-wma --with-wmv --with-pcm --with-dts --with-eac3"

PREFERRED_PROVIDER_virtual/enigma2-mediaservice = "enigma2-plugin-systemplugins-servicehisilicon"

DEPENDS_append_pn-enigma2 = " dinobot-libs-${MACHINETYPE} "
```

## conf/machine/include/u41.inc
```bitbake
EXTRA_OECONF_append_pn-enigma2 = "--with-lcddev=/dev/null --with-alphablendingacceleration=always"

SOC_FAMILY = "hisi3716mv410"

KERNEL_MODULE_AUTOLOAD += "8192eu"

require conf/machine/include/dinobot-cortexa9.inc
require conf/machine/include/dinobot-ubi.inc

PREFERRED_PROVIDER_virtual/blindscan-dvbs = "dinobot-blindscan-u41"

MACHINE_ESSENTIAL_EXTRA_RDEPENDS += "\
    dinobot-dvb-modules-u41 \
    dinobot-libs-u41 \
    dinobot-hihalt-u41 \
"

PREFERRED_RPROVIDER_showiframe = "dinobot-showiframe-u41"
PREFERRED_RPROVIDER_aio-grab = "dinobot-grab-u41"

MACHINETYPE = "u41"

MTD_KERNEL = "mtd8"
MTD_ROOTFS = "mtd9"

SDCARDIMG = "no"

MACHINE_FEATURES += "blindscan-dvbs textlcd"
```

## conf/machine/include/u42.inc
```bitbake
EXTRA_OECONF_append_pn-enigma2 = "--with-lcddev=/dev/null --with-alphablendingacceleration=always"

SOC_FAMILY = "hisi3716mv410"

KERNEL_MODULE_AUTOLOAD += "8192eu"

require conf/machine/include/dinobot-cortexa9.inc
require conf/machine/include/dinobot-ubi.inc

PREFERRED_PROVIDER_virtual/blindscan-dvbs = "dinobot-blindscan-u42"

MACHINE_ESSENTIAL_EXTRA_RDEPENDS += "\
    dinobot-dvb-modules-u42 \
    dinobot-libs-u42 \
    dinobot-hihalt-u42 \
"

PREFERRED_RPROVIDER_showiframe = "dinobot-showiframe-u42"
PREFERRED_RPROVIDER_aio-grab = "dinobot-grab-u42"

MACHINETYPE = "u42"

MTD_KERNEL = "mtd8"
MTD_ROOTFS = "mtd11"

SDCARD = "no"

MACHINE_FEATURES += "RCA blindscan-dvbs"

IMAGEDIR = "dinobot/u42"
```

## conf/machine/include/u43.inc
```bitbake
EXTRA_OECONF_append_pn-enigma2 = "--with-lcddev=/dev/null --with-alphablendingacceleration=always"

SOC_FAMILY = "hisi3716mv410"

KERNEL_MODULE_AUTOLOAD += "8192eu"

require conf/machine/include/dinobot-cortexa9.inc
require conf/machine/include/dinobot-ubi.inc

MACHINE_ESSENTIAL_EXTRA_RDEPENDS += "\
    dinobot-dvb-modules-u43 \
    dinobot-libs-u43 \
    dinobot-hihalt-u43 \
"

PREFERRED_RPROVIDER_showiframe = "dinobot-showiframe-u43"
PREFERRED_RPROVIDER_aio-grab = "dinobot-grab-u43"

MACHINETYPE = "u43"

MTD_KERNEL = "mtd8"
MTD_ROOTFS = "mtd11"

SDCARD = "no"

MACHINE_FEATURES += "RCA dvb-c 7segment textlcd"

IMAGEDIR = "dinobot/u43"
```

## conf/machine/include/u5.inc
```bitbake
EXTRA_OECONF_append_pn-enigma2 = "--with-lcddev=/dev/null --with-alphablendingacceleration=always"

SOC_FAMILY = "hisi3798mv200"
HICHIPSET = "3798mv200"
CHIPSET = "Hi3798Mv200"

KERNEL_MODULE_AUTOLOAD += "8192eu"

require conf/machine/include/dinobot-cortexa15.inc
require conf/machine/include/dinobot-emmc.inc

PREFERRED_PROVIDER_virtual/blindscan-dvbs = "dinobot-blindscan-u5"

MACHINE_ESSENTIAL_EXTRA_RDEPENDS += "\
	dinobot-dvb-modules-u5 \
	dinobot-libs-u5 \
	dinobot-hihalt-u5 \
	"

PREFERRED_RPROVIDER_showiframe = "dinobot-showiframe-u5"
PREFERRED_RPROVIDER_aio-grab = "dinobot-grab-u5"

MACHINETYPE = "u5"

MACHINE_FEATURES += "7segment blindscan-dvbs textlcd hiaccel RCA"

IMAGEDIR = "dinobot/u5"

STB_PLATFORM = "u5"

EXTRA_ALSA = "mv200"
```

## conf/machine/include/u51.inc
```bitbake
EXTRA_OECONF_append_pn-enigma2 = "--with-lcddev=/dev/null --with-alphablendingacceleration=always"

SOC_FAMILY = "hisi3798mv200"
HICHIPSET = "3798mv200"
CHIPSET = "Hi3798Mv200"

KERNEL_MODULE_AUTOLOAD += "8192eu"

require conf/machine/include/dinobot-cortexa15.inc
require conf/machine/include/dinobot-emmc.inc

PREFERRED_PROVIDER_virtual/blindscan-dvbs = "dinobot-blindscan-u51"

MACHINE_ESSENTIAL_EXTRA_RDEPENDS += "\
	dinobot-dvb-modules-u51 \
	dinobot-libs-u51 \
	dinobot-hihalt-u51 \
	"

PREFERRED_RPROVIDER_showiframe = "dinobot-showiframe-u51"
PREFERRED_RPROVIDER_aio-grab = "dinobot-grab-u51"

MACHINETYPE = "u51"

MTD_KERNEL = "mmcblk0p9"
MTD_ROOTFS = "mmcblk0p10"

MACHINE_FEATURES += "7segment blindscan-dvbs textlcd hiaccel RCA"

STB_PLATFORM = "u51"

EXTRA_ALSA = "mv200"
```
